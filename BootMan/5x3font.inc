; 5x3 font for BootMan

#define MAPBIT(x, from, to) ((((x) >> (from)) & 1) << (to))

#define SHIFT5X3(x) (\
MAPBIT(x, 15, 0) | \
MAPBIT(x, 14, 5) | \
MAPBIT(x, 13, 10) | \
MAPBIT(x, 12, 1) | \
MAPBIT(x, 11, 6) | \
MAPBIT(x, 10, 11) | \
MAPBIT(x, 9, 2) | \
MAPBIT(x, 8, 7) | \
MAPBIT(x, 7, 12) | \
MAPBIT(x, 6, 3) | \
MAPBIT(x, 5, 8) | \
MAPBIT(x, 4, 13) | \
MAPBIT(x, 3, 4) | \
MAPBIT(x, 2, 9) | \
MAPBIT(x, 1, 14) | \
MAPBIT(x, 0, 15) \
)

.macro CHAR5X3
.dw SHIFT5X3(@0)
.endmacro

.macro FONT5X3
	; 5x3 ASCII font from 0x20 to 0x7F
	CHAR5X3 0b000_000_000_000_000_0 ;spc
	CHAR5X3 0b010_010_010_000_010_0 ;!
	CHAR5X3 0b101_101_000_000_000_0 ;"
	CHAR5X3 0b010_111_010_111_010_0 ;#
	CHAR5X3 0b010_011_110_011_010_0 ;$
	CHAR5X3 0b100_001_010_100_001_0 ;%
	CHAR5X3 0b010_101_010_101_011_0 ;&
	CHAR5X3 0b010_010_000_000_000_0 ;'
	CHAR5X3 0b001_010_010_010_001_0 ;(
	CHAR5X3 0b100_010_010_010_100_0 ;)
	CHAR5X3 0b000_101_010_101_000_0 ;*
	CHAR5X3 0b000_010_111_010_000_0 ;+
	CHAR5X3 0b000_000_000_010_100_0 ;,
	CHAR5X3 0b000_000_111_000_000_0 ;-
	CHAR5X3 0b000_000_000_000_010_0 ;.
	CHAR5X3 0b000_001_010_100_000_0 ;/

	CHAR5X3 0b111_101_101_101_111_0 ;0
	CHAR5X3 0b010_110_010_010_111_0 ;1
	CHAR5X3 0b110_001_010_100_111_0 ;2
	CHAR5X3 0b110_001_110_001_110_0 ;3
	CHAR5X3 0b101_101_111_001_001_0 ;4
	CHAR5X3 0b111_100_110_001_110_0 ;5
	CHAR5X3 0b011_100_110_101_010_0 ;6
	CHAR5X3 0b111_001_001_001_001_0 ;7
	CHAR5X3 0b010_101_010_101_010_0 ;8
	CHAR5X3 0b010_101_011_001_110_0 ;9
	CHAR5X3 0b000_010_000_010_000_0 ;:
	CHAR5X3 0b000_010_000_010_100_0 ;;
	CHAR5X3 0b001_010_100_010_001_0 ;<
	CHAR5X3 0b000_111_000_111_000_0 ;=
	CHAR5X3 0b100_010_001_010_100_0 ;>
	CHAR5X3 0b110_001_010_000_010_0 ;?

	CHAR5X3 0b011_101_101_100_011_0 ;@
	CHAR5X3 0b010_101_111_101_101_0 ;A
	CHAR5X3 0b110_101_110_101_110_0 ;B
	CHAR5X3 0b011_100_100_100_011_0 ;C
	CHAR5X3 0b110_101_101_101_110_0 ;D
	CHAR5X3 0b111_100_111_100_111_0 ;E
	CHAR5X3 0b111_100_111_100_100_0 ;F
	CHAR5X3 0b011_100_101_101_011_0 ;G
	CHAR5X3 0b101_101_111_101_101_0 ;H
	CHAR5X3 0b111_010_010_010_111_0 ;I
	CHAR5X3 0b111_001_001_101_011_0 ;J
	CHAR5X3 0b101_101_110_101_101_0 ;K
	CHAR5X3 0b100_100_100_100_111_0 ;L
	CHAR5X3 0b101_111_111_101_101_0 ;M
	CHAR5X3 0b001_101_111_101_100_0 ;N
	CHAR5X3 0b010_101_101_101_010_0 ;O

	CHAR5X3 0b110_101_110_100_100_0 ;P
	CHAR5X3 0b010_101_101_101_011_0 ;Q
	CHAR5X3 0b110_101_111_110_101_0 ;R
	CHAR5X3 0b011_100_010_001_110_0 ;S
	CHAR5X3 0b111_010_010_010_010_0 ;T
	CHAR5X3 0b101_101_101_101_011_0 ;U
	CHAR5X3 0b101_101_101_101_010_0 ;V
	CHAR5X3 0b101_101_111_111_101_0 ;W
	CHAR5X3 0b101_101_010_101_101_0 ;X
	CHAR5X3 0b101_101_010_010_010_0 ;Y
	CHAR5X3 0b111_001_010_100_111_0 ;Z
	CHAR5X3 0b011_010_010_010_011_0 ;[
	CHAR5X3 0b000_100_010_001_000_0 ;\
	CHAR5X3 0b110_010_010_010_110_0 ;]
	CHAR5X3 0b010_101_000_000_000_0 ;^
	CHAR5X3 0b000_000_000_000_111_0 ;_

	CHAR5X3 0b100_010_000_000_000_0 ;`
	CHAR5X3 0b000_000_011_101_011_0 ;a
	CHAR5X3 0b100_100_110_101_110_0 ;b
	CHAR5X3 0b000_000_011_100_011_0 ;c
	CHAR5X3 0b001_001_011_101_011_0 ;d
	CHAR5X3 0b000_000_010_111_011_0 ;e
	CHAR5X3 0b001_010_011_010_010_0 ;f
	CHAR5X3 0b011_101_011_001_110_0 ;g
	CHAR5X3 0b100_100_110_101_101_0 ;h
	CHAR5X3 0b010_000_010_010_010_0 ;i
	CHAR5X3 0b010_000_110_010_100_0 ;j
	CHAR5X3 0b100_100_101_110_101_0 ;k
	CHAR5X3 0b010_010_010_010_010_0 ;l
	CHAR5X3 0b000_101_111_101_101_0 ;m
	CHAR5X3 0b000_000_110_101_101_0 ;n
	CHAR5X3 0b000_000_010_101_010_0 ;o

	CHAR5X3 0b000_110_101_110_100_0 ;p
	CHAR5X3 0b000_011_101_011_001_0 ;q
	CHAR5X3 0b000_000_011_010_010_0 ;r
	CHAR5X3 0b000_000_011_010_110_0 ;s
	CHAR5X3 0b010_010_011_010_001_0 ;t
	CHAR5X3 0b000_000_101_101_011_0 ;u
	CHAR5X3 0b000_000_101_101_010_0 ;v
	CHAR5X3 0b000_101_101_111_101_0 ;w
	CHAR5X3 0b000_000_101_010_101_0 ;x
	CHAR5X3 0b101_101_011_001_110_0 ;y
	CHAR5X3 0b000_000_110_010_011_0 ;z
	CHAR5X3 0b011_010_100_010_011_0 ;{
	CHAR5X3 0b010_010_010_010_010_0 ;|
	CHAR5X3 0b110_010_001_010_110_0 ;}
	CHAR5X3 0b000_011_110_000_000_0 ;~
	CHAR5X3 0b111_111_111_111_111_0 ;(unsupported char / block)
.endmacro
